## CMakeLists.txt
```
# SPDX-License-Identifier: Apache-2.0

cmake_minimum_required(VERSION 3.20.0)

find_package(Zephyr REQUIRED HINTS $ENV{ZEPHYR_BASE})
project(Laz_keyboard_wireless)

target_sources(app PRIVATE
    src/main.c
    src/laz_bluetooth/laz_bluetooth.c
    src/laz_bluetooth/laz_bluetooth_hid_service.c
)
```

## prj.conf
```kconfig
# logging
CONFIG_LOG=y
CONFIG_LOG_MODE_IMMEDIATE=y
CONFIG_LOG_IMMEDIATE_CLEAN_OUTPUT=y
CONFIG_LOG_INFO_COLOR_GREEN=y
CONFIG_LOG_BACKEND_UART=n

# bluetooth
CONFIG_BT=y
CONFIG_BT_DEBUG_LOG=y
CONFIG_BT_PERIPHERAL=y
CONFIG_BT_DEVICE_NAME="Laz_keyboard"
CONFIG_BT_DEVICE_APPEARANCE=962
```

## src/main.c
```c
#include <zephyr/kernel.h>
#include <zephyr/logging/log.h>

#include "laz_bluetooth/laz_bluetooth.h"

LOG_MODULE_REGISTER(Laz_keyboard_wireless, LOG_LEVEL_DBG);

int main(void)
{
	LOG_INF("Hello World! %s\n", CONFIG_BOARD);

	laz_bluetooth_init();

	while(1)
	{
		k_sleep(K_HOURS(1));
	}
	return 0;
}
```
